## tools/overlay/security/kryonk/Kconfig
```kconfig
config SECURITY_KRYONK
	bool "Kryonux kernel guard"
	depends on SECURITY
	default y
	help
	  Kryonux kernel guard. Exposes /proc/kryonk with the layer version
	  and the current hardening state, and enforces restrictive boot
	  defaults for kernel pointer exposure, dmesg access and oops
	  handling. Disable with the kryonk.guard=0 boot parameter.
```
